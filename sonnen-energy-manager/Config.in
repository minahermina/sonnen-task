## sonnen-energy-manager/Config.in
```kconfig
source "$BR2_EXTERNAL_SONNEN_ENERGY_MANAGER_PATH/package/sonnen-energy-manager/Config.in"
```

## sonnen-energy-manager/package/sonnen-energy-manager/Config.in
```kconfig
config BR2_PACKAGE_SONNEN_ENERGY_MANAGER
	bool "sonnen-energy-manager"
	help
	  The Sonnen Energy Manager
```
